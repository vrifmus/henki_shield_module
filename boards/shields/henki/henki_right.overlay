#include "henki.dtsi" // Notice that the main dtsi files are included in the overlay.

&default_transform { // The matrix transform for this board is 5 columns over because the left half is 5 columns wide according to the matrix.
    col-offset = <5>;
};

&kscan0 {
    col-gpios
        = <&pro_micro 5 GPIO_ACTIVE_HIGH> // col6 in the schematic
        , <&pro_micro 6 GPIO_ACTIVE_HIGH> // col7 in the schematic
        , <&pro_micro 7 GPIO_ACTIVE_HIGH> // col8 in the schematic
        , <&pro_micro 8 GPIO_ACTIVE_HIGH> // col9 in the schematic
        , <&pro_micro 9 GPIO_ACTIVE_HIGH>  // col10 in the schematic
        ;
};
