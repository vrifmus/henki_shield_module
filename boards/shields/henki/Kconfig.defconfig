## boards/shields/henki/Kconfig.defconfig
```kconfig
if SHIELD_HENKI_LEFT

config ZMK_KEYBOARD_NAME
    default "hEnki"

config ZMK_SPLIT_ROLE_CENTRAL
    default y

endif

if SHIELD_HENKI_LEFT || SHIELD_HENKI_RIGHT

config ZMK_SPLIT
    default y

endif
```

## boards/shields/henki/Kconfig.shield
```kconfig
config SHIELD_HENKI_LEFT
    def_bool $(shields_list_contains,henki_left)

config SHIELD_HENKI_RIGHT
    def_bool $(shields_list_contains,henki_right)
```
